## config/west.yml
```yaml
manifest:
  defaults:
    revision: v0.3
  remotes:
    - name: zmkfirmware
      url-base: https://github.com/zmkfirmware
    - name: petejohanson
      url-base: https://github.com/petejohanson
    - name: albertclee
      url-base: https://github.com/alee0729
    - name: caksoylar
      url-base: https://github.com/caksoylar
    - name: carrefinho
      url-base: https://github.com/carrefinho
    - name: prospector
      url-base: https://github.com/t-ogura
    - name: geeksville
      url-base: https://github.com/geeksville
    - name: janpfischer
      url-base: https://github.com/Dexter-KBD
    - name: kot149
      url-base: https://github.com/kot149
    - name: amgskobo
      url-base: https://github.com/amgskobo

  projects:
    - name: zmk
      remote: zmkfirmware
      revision: v0.3
      import: app/west.yml
    - name: cirque-input-module
      remote: geeksville
      revision: toucan
    - name: zmk-rgbled-widget
      remote: caksoylar
      revision: v0.3
    - name: prospector-zmk-module
      remote: carrefinho
      revision: main
    - name: zmk-dongle-screen
      remote: albertclee
      revision: main
    - name: zmk-scroll-snap
      remote: kot149
      revision: v1
    - name: zmk-input-inertia
      remote: amgskobo
      revision: main

  self:
    path: config
```
